## config/west.yml
```yaml
manifest:
  defaults:
    remote: urob
    revision: main
  remotes:
    - name: zmkfirmware
      url-base: https://github.com/zmkfirmware
    - name: urob
      url-base: https://github.com/urob
    - name: infely
      url-base: https://github.com/infely
  projects:
    - name: zmk
      remote: zmkfirmware
      import: app/west.yml
    - name: zmk-helpers
    - name: zmk-auto-layer
    - name: zephyr
      remote: zmkfirmware
      revision: v4.1.0+zmk-fixes
      clone-depth: 1
      import:
        name-allowlist: [cmsis, hal_nordic, hal_rpi_pico, hal_stm32, lvgl, mbedtls, tinycrypt]
  self:
    path: config
```
