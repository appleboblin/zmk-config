#include <behaviors.dtsi>
#include <behaviors/num_word.dtsi> // requires auto-layer module
#include <dt-bindings/zmk/keys.h>
#include <dt-bindings/zmk/bt.h>

// Lots of config from urob
#include "zmk-helpers/helper.h" // Requires zmk-helpers module
#include "zmk-helpers/key-labels/42.h"

#define GRAPHITE 0
#define QWERT 1
#define NUMROW 2
#define NAV 3
#define FN 4
#define NUMPAD 5
#define SYS 6

#define XXX &none
#define ___ &trans

#define QUICK_TAP_MS 175

&sk {  // sticky-key config
    release-after-ms = <900>;  // release after 0.9s
    quick-release;             // no double capitalization when rolling keys
};

&lt {  // layer-tap config
   flavor = "balanced";
   tapping-term-ms = <200>;
   quick-tap-ms = <QUICK_TAP_MS>;
};

&sl {  // sticky-layer config
    ignore-modifiers;          // allow chording sticky mods & layers
};

/* Homerow mods */
/*                KEY POSITIONS
   --------------------------------------------------------------------------------
   |  0   |  1  |  2  |  3  |  4  |  5  |   |  6  |  7   |  8  |  9  |  10 |  11  |
   |  12  |  13 |  14 |  15 |  16 |  17 |   |  18 |  19  |  20 |  21 |  22 |  23  |
   |  24  |  25 |  26 |  27 |  28 |  29 |   |  30 |  31  |  31 |  33 |  34 |  35  |
                      |  36 |  37 |  38 |   |  39 |  40  |  41 |

   ╭─────────────────────────╮ ╭─────────────────────────╮
   │ LT5 LT4 LT3 LT2 LT1 LT0 │ │ RT0 RT1 RT2 RT3 RT4 RT5 │
   │ LM5 LM4 LM3 LM2 LM1 LM0 │ │ RM0 RM1 RM2 RM3 RM4 RM5 │
   │ LB5 LB4 LB3 LB2 LB1 LB0 │ │ RB0 RB1 RB2 RB3 RB4 RB5 │
   ╰───────────╮ LH2 LH1 LH0 │ │ RH0 RH1 RH2 ╭───────────╯
               ╰─────────────╯ ╰─────────────╯ */

#define KEYS_L LT0 LT1 LT2 LT3 LT4 LT5 LM0 LM1 LM2 LM3 LM4 LM5 LB0 LB1 LB2 LB3 LB4 LB5  // left hand
#define KEYS_R RT0 RT1 RT2 RT3 RT4 RT5 RM0 RM1 RM2 RM3 RM4 RM5 RB0 RB1 RB2 RB3 RB4 RB5  // right hand
#define THUMBS LH2 LH1 LH0 RH0 RH1 RH2                                  // thumbs on 36+ keys

#define MAKE_HRM(NAME, HOLD, TAP, TRIGGER_POS) \
   ZMK_HOLD_TAP(NAME, \
      flavor = "balanced"; \
      tapping-term-ms = <250>; \
      quick-tap-ms = <QUICK_TAP_MS>; \
      require-prior-idle-ms = <150>; \
      bindings = <HOLD>, <TAP>; \
      hold-trigger-key-positions = <TRIGGER_POS>; \
      hold-trigger-on-release; \
   )
MAKE_HRM(hml, &kp, &kp, KEYS_R THUMBS)  // left-hand HRMs
MAKE_HRM(hmr, &kp, &kp, KEYS_L THUMBS)  // right-hand HRMs

#include "combos.dtsi" // after hrm

/* Caps-word, num-word */
// tap: sticky-shift | shift + tap/ double-tap: caps-word | hold: shift
ZMK_MOD_MORPH(smart_shft,
   bindings = <&sk LSHFT>, <&caps_word>;
   mods = <(MOD_LSFT)>;
)
&caps_word {  // mods deactivate caps-word, requires PR #1451
   /delete-property/ ignore-modifiers;
};
// tap: sticky |  hold: kp | for tap: sticky rshft, hold: rshft
ZMK_HOLD_TAP(shift2,
   flavor = "balanced";
   tapping-term-ms = <200>;
   quick-tap-ms = <QUICK_TAP_MS>;
   bindings = <&kp>, <&sk>;
)
// tap: esc hold: ctrl
ZMK_HOLD_TAP(ce,
   flavor = "balanced";
   tapping-term-ms = <130>;
   bindings = <&kp>, <&kp>;
)
// tap: num-word | double-tap: sticky num-layer | hold: num-layer
ZMK_HOLD_TAP(smart_num,
   flavor = "balanced";
   tapping-term-ms = <200>;
   quick-tap-ms = <QUICK_TAP_MS>;
   bindings = <&mo>, <&num_dance>;
)
ZMK_TAP_DANCE(num_dance,
   tapping-term-ms = <200>;
   bindings = <&sl NUMPAD>, <&num_word NUMPAD>;
)

// Thumb clusters
// tap: alt | double-tap: enter | hold: numrow
ZMK_TAP_DANCE(nralte,
   tapping-term-ms = <250>;
   bindings = <&lt NUMROW LALT>, <&kp ENTER>;
)
// tap/hold: LGUI | double-tap: Function layer
ZMK_TAP_DANCE(gui_fn,
   tapping-term-ms = <250>;
   bindings = <&kp LGUI>, <&mo FN>;
)

/* Nav cluster */
// long-tap action on hold, short-tap action on all interrupts
#define MT_CORE \
   flavor = "tap-preferred"; \
   tapping-term-ms = <220>; \
   quick-tap-ms = <220>; \
   hold-trigger-key-positions = <0>;

&mt { MT_CORE };
ZMK_HOLD_TAP(mt_home, bindings = <&masked_home>, <&kp>; MT_CORE)
ZMK_HOLD_TAP(mt_end, bindings = <&masked_end>, <&kp>; MT_CORE)

#define NAV_LEFT  &mt_home 0   LEFT    // tap: left  | long-tap: beginning of line
#define NAV_RIGHT &mt_end 0    RIGHT   // tap: right | long-tap: end       of line
#define NAV_UP    &mt LC(HOME) UP      // tap: up    | long-tap: beginning of document
#define NAV_DOWN  &mt LC(END)  DOWN    // tap: down  | long-tap: end       of document
#define NAV_BSPC  &mt LC(BSPC) BSPC    // tap: bspc  | long-tap: delete word backward
#define NAV_DEL   &mt LC(DEL)  DEL     // tap: del   | long-tap: delete word forward

// mask CTRL when holding left/right to avoid accidental jumps to beginning/end of document
#define MASK_MODS(NAME, MODS, BINDING) \
   ZMK_MOD_MORPH(NAME, \
      bindings = <BINDING>, <BINDING>; \
      mods = <MODS>; \
   )
MASK_MODS(masked_home, (MOD_LCTL), &kp HOME)
MASK_MODS(masked_end,  (MOD_LCTL), &kp END)

// misc aliases
#define CANCEL      &kp K_CANCEL             // cancel caps-word, num-word

// tap: copy | double-tap: ctrl+shft+c
ZMK_TAP_DANCE(f_copy,
    tapping-term-ms = <200>;
    bindings = <&kp LC(C)>, <&kp LC(LS(C))>;
)
// tap: paste | double-tap: ctrl+shft+v
ZMK_TAP_DANCE(f_paste,
    tapping-term-ms = <200>;
    bindings = <&kp LC(V)>, <&kp LC(LS(V))>;
)
// tap: cut | double-tap: ctrl+shft+x
ZMK_TAP_DANCE(f_cut,
    tapping-term-ms = <200>;
    bindings = <&kp LC(X)>, <&kp LC(LS(X))>;
)
// tap: back | double-tap: ctrl+shft+z
ZMK_TAP_DANCE(f_back,
    tapping-term-ms = <200>;
    bindings = <&kp LC(Z)>, <&kp LC(LS(Z))>;
)
// tap: select all | double-tap: ctrl+shft+a
ZMK_TAP_DANCE(f_all,
    tapping-term-ms = <200>;
    bindings = <&kp LC(A)>, <&kp LC(LS(A))>;
)

/* Keymap */
ZMK_CONDITIONAL_LAYER(sys, FN NUMROW, SYS)  // Function + NumRow -> sys

// Graphite special shift
// Define mod-morph with a *single* mod trigger for less repetition.
#define SIMPLE_MORPH(NAME, MOD, BINDING1, BINDING2)                            \
  ZMK_MOD_MORPH(NAME, mods = <(MOD_L##MOD | MOD_R##MOD)>;                      \
                bindings = <BINDING1>, <BINDING2>;)

// Tap: quote | Shift + tap: underscore
SIMPLE_MORPH(quote,  SFT, &kp SQT,  &kp UNDER)

// Tap: comma | Shift + tap: qmark
SIMPLE_MORPH(comma,  SFT, &kp COMMA, &kp QMARK)

// Tap: hyphen | Shift + tap: double quote
SIMPLE_MORPH(hyphen, SFT, &kp MINUS, &kp DQT)

// Tap: slash | Shift + tap: less-than
SIMPLE_MORPH(slash,  SFT, &kp FSLH,  &kp LT)

// Combo keys
// Tap: left/right parenthesis | Shift + tap: less-than/greater-than
SIMPLE_MORPH(lplt,   SFT, &kp LPAR,  &kp LT)
SIMPLE_MORPH(rpgt,   SFT, &kp RPAR,  &kp GT)

// keymap-drawer can't see into tap-dances; draw gui_fn as a layer-tap so the
// Function layer's activator key is detected and highlighted.
#ifdef KEYMAP_DRAWER
#define GUI_FN &lt FN LGUI
#else
#define GUI_FN &gui_fn
#endif

ZMK_LAYER(Graphite,
//╭─────────────┬─────────────┬─────────────┬─────────────┬─────────────┬─────────────╮ ╭─────────────┬─────────────┬─────────────┬─────────────┬─────────────┬─────────────╮
   &kp TAB       &kp B         &kp L         &kp D         &kp W         &kp Z           &quote        &kp F         &kp O         &kp U         &kp J         &kp SEMI
//├─────────────┼─────────────┼─────────────┼─────────────┼─────────────┼─────────────┤ ├─────────────┼─────────────┼─────────────┼─────────────┼─────────────┼─────────────┤
   &ce LCTRL ESC &hml LCTRL N  &hml LALT R   &hml LSHFT T  &hml LGUI S   &kp G           &kp Y         &hmr RGUI H   &hmr LSHFT A  &hmr LALT E   &hmr RCTRL I  &comma
//├─────────────┼─────────────┼─────────────┼─────────────┼─────────────┼─────────────┤ ├─────────────┼─────────────┼─────────────┼─────────────┼─────────────┼─────────────┤
   &smart_shft   &kp Q         &kp X         &kp M         &kp C         &kp V           &kp K         &kp P         &kp DOT       &hyphen       &slash        &shift2 RSHFT RSHFT
//╰─────────────┴─────────────┴─────────────┼─────────────┼─────────────┼─────────────┤ ├─────────────┼─────────────┼─────────────┼─────────────┴─────────────┴─────────────╯
                                             &kp LALT      GUI_FN        NAV_BSPC        &lt NAV SPACE &lt NUMROW ENTER &smart_num NUMPAD GRAPHITE
//                                          ╰─────────────┴─────────────┴─────────────╯ ╰─────────────┴─────────────┴─────────────╯
)

ZMK_LAYER(QWERTY,
//╭─────────────┬─────────────┬─────────────┬─────────────┬─────────────┬─────────────╮ ╭─────────────┬─────────────┬─────────────┬─────────────┬─────────────┬─────────────╮
   &kp TAB       &kp Q         &kp W         &kp E         &kp R         &kp T           &kp Y         &kp U         &kp I         &kp O         &kp P         &kp BSLH
//├─────────────┼─────────────┼─────────────┼─────────────┼─────────────┼─────────────┤ ├─────────────┼─────────────┼─────────────┼─────────────┼─────────────┼─────────────┤
   &ce LCTRL ESC &hml LCTRL A  &hml LALT S   &hml LSHFT D  &hml LGUI F   &kp G           &kp H         &hmr RGUI J   &hmr RSHFT K  &hmr RALT L   &hmr RCTRL SEMI &kp SQT
//├─────────────┼─────────────┼─────────────┼─────────────┼─────────────┼─────────────┤ ├─────────────┼─────────────┼─────────────┼─────────────┼─────────────┼─────────────┤
   &smart_shft   &kp Z         &kp X         &kp C         &kp V         &kp B           &kp N         &kp M         &kp COMMA     &kp DOT       &kp FSLH      &shift2 RSHFT RSHFT
//╰─────────────┴─────────────┴─────────────┼─────────────┼─────────────┼─────────────┤ ├─────────────┼─────────────┼─────────────┼─────────────┴─────────────┴─────────────╯
                                             &kp LALT      GUI_FN        NAV_BSPC        &lt NAV SPACE &lt NUMROW ENTER &smart_num NUMPAD QWERT
//                                          ╰─────────────┴─────────────┴─────────────╯ ╰─────────────┴─────────────┴─────────────╯
)

ZMK_LAYER(NumRow,
//╭─────────────┬─────────────┬─────────────┬─────────────┬─────────────┬─────────────╮ ╭─────────────┬─────────────┬─────────────┬─────────────┬─────────────┬─────────────╮
   ___           ___           &kp LT        &kp LBKT      &kp LBRC      ___             ___           &kp RBRC      &kp RBKT      &kp GT        ___           ___
//├─────────────┼─────────────┼─────────────┼─────────────┼─────────────┼─────────────┤ ├─────────────┼─────────────┼─────────────┼─────────────┼─────────────┼─────────────┤
   ___           &kp N1        &kp N2        &kp N3        &kp N4        &kp EQUAL       ___           &kp N7        &kp N8        &kp N9        &kp N0        ___
//├─────────────┼─────────────┼─────────────┼─────────────┼─────────────┼─────────────┤ ├─────────────┼─────────────┼─────────────┼─────────────┼─────────────┼─────────────┤
   ___           ___           ___           ___           &kp N5        ___             ___           &kp N6        ___           ___           ___           ___
//╰─────────────┴─────────────┴─────────────┼─────────────┼─────────────┼─────────────┤ ├─────────────┼─────────────┼─────────────┼─────────────┴─────────────┴─────────────╯
                                             ___           ___           ___             ___           ___           ___
//                                          ╰─────────────┴─────────────┴─────────────╯ ╰─────────────┴─────────────┴─────────────╯
)

ZMK_LAYER(Nav,
//╭─────────────┬─────────────┬─────────────┬─────────────┬─────────────┬─────────────╮ ╭─────────────┬─────────────┬─────────────┬─────────────┬─────────────┬─────────────╮
   ___           ___           ___           ___           ___           &kp CAPS        ___           ___           ___           ___           ___           ___
//├─────────────┼─────────────┼─────────────┼─────────────┼─────────────┼─────────────┤ ├─────────────┼─────────────┼─────────────┼─────────────┼─────────────┼─────────────┤
   ___           &f_back       &f_cut        &f_copy       &f_paste      ___             NAV_LEFT      NAV_DOWN      NAV_UP        NAV_RIGHT     ___           ___
//├─────────────┼─────────────┼─────────────┼─────────────┼─────────────┼─────────────┤ ├─────────────┼─────────────┼─────────────┼─────────────┼─────────────┼─────────────┤
   ___           ___           ___           ___           &f_all        ___             &kp HOME      &kp PG_DN     &kp PG_UP     &kp END       ___           ___
//╰─────────────┴─────────────┴─────────────┼─────────────┼─────────────┼─────────────┤ ├─────────────┼─────────────┼─────────────┼─────────────┴─────────────┴─────────────╯
                                             ___           CANCEL        NAV_DEL         ___           ___           ___
//                                          ╰─────────────┴─────────────┴─────────────╯ ╰─────────────┴─────────────┴─────────────╯
)

ZMK_LAYER(Function,
//╭─────────────┬─────────────┬─────────────┬─────────────┬─────────────┬─────────────╮ ╭─────────────┬─────────────┬─────────────┬─────────────┬─────────────┬─────────────╮
   &kp ESC       &kp F12       &kp F7        &kp F8        &kp F9        ___             ___           &kp C_BRI_DN  &kp C_BRI_UP  ___           &kp PG_UP     &kp DEL
//├─────────────┼─────────────┼─────────────┼─────────────┼─────────────┼─────────────┤ ├─────────────┼─────────────┼─────────────┼─────────────┼─────────────┼─────────────┤
   &kp LCTRL     &kp F11       &kp F4        &kp F5        &kp F6        ___             &kp PSCRN     &kp C_VOL_DN  &kp C_VOL_UP  &kp C_MUTE    &kp PG_DN     &kp INS
//├─────────────┼─────────────┼─────────────┼─────────────┼─────────────┼─────────────┤ ├─────────────┼─────────────┼─────────────┼─────────────┼─────────────┼─────────────┤
   &kp LSHFT     &kp F10       &kp F1        &kp F2        &kp F3        ___             ___           &kp C_NEXT    &kp C_PP      &kp C_PREV    &kp HOME      &kp END
//╰─────────────┴─────────────┴─────────────┼─────────────┼─────────────┼─────────────┤ ├─────────────┼─────────────┼─────────────┼─────────────┴─────────────┴─────────────╯
                                             &kp LALT      ___           ___             ___           ___           ___
//                                          ╰─────────────┴─────────────┴─────────────╯ ╰─────────────┴─────────────┴─────────────╯
)

ZMK_LAYER(Numpad,
//╭─────────────┬─────────────┬─────────────┬─────────────┬─────────────┬─────────────╮ ╭─────────────┬─────────────┬─────────────┬─────────────┬─────────────┬─────────────╮
   &kp TAB       &kp STAR      &kp N7        &kp N8        &kp N9        &kp MINUS       ___           ___           &kp UP        ___           ___           ___
//├─────────────┼─────────────┼─────────────┼─────────────┼─────────────┼─────────────┤ ├─────────────┼─────────────┼─────────────┼─────────────┼─────────────┼─────────────┤
   &kp BSPC      &kp EQUAL     &kp N4        &kp N5        &kp N6        &kp PLUS        ___           &kp LEFT      &kp DOWN      &kp RIGHT     ___           ___
//├─────────────┼─────────────┼─────────────┼─────────────┼─────────────┼─────────────┤ ├─────────────┼─────────────┼─────────────┼─────────────┼─────────────┼─────────────┤
   &kp BSPC      &kp BSPC      &kp N1        &kp N2        &kp N3        &kp SLASH       ___           ___           ___           ___           ___           ___
//╰─────────────┴─────────────┴─────────────┼─────────────┼─────────────┼─────────────┤ ├─────────────┼─────────────┼─────────────┼─────────────┴─────────────┴─────────────╯
                                             &kp KP_DOT    &kp N0        &kp ENTER       ___           ___           ___
//                                          ╰─────────────┴─────────────┴─────────────╯ ╰─────────────┴─────────────┴─────────────╯
)

ZMK_LAYER(sys,
//╭─────────────┬─────────────┬─────────────┬─────────────┬─────────────┬─────────────╮ ╭─────────────┬─────────────┬─────────────┬─────────────┬─────────────┬─────────────╮
   ___           ___           ___           ___           &sys_reset    &bootloader     &bootloader   &sys_reset    ___           ___           ___           ___
//├─────────────┼─────────────┼─────────────┼─────────────┼─────────────┼─────────────┤ ├─────────────┼─────────────┼─────────────┼─────────────┼─────────────┼─────────────┤
   ___           ___           ___           &to QWERT     &to GRAPHITE  ___             ___           ___           ___           ___           ___           ___
//├─────────────┼─────────────┼─────────────┼─────────────┼─────────────┼─────────────┤ ├─────────────┼─────────────┼─────────────┼─────────────┼─────────────┼─────────────┤
   &bt BT_CLR    &bt BT_SEL 0  &bt BT_SEL 1  &bt BT_SEL 2  &bt BT_SEL 3  &bt BT_SEL 4    ___           ___           ___           ___           ___           ___
//╰─────────────┴─────────────┴─────────────┼─────────────┼─────────────┼─────────────┤ ├─────────────┼─────────────┼─────────────┼─────────────┴─────────────┴─────────────╯
                                             ___           ___           ___             ___           ___           ___
//                                          ╰─────────────┴─────────────┴─────────────╯ ╰─────────────┴─────────────┴─────────────╯
)
